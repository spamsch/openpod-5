## esp32-ble-advertiser/sdkconfig.defaults
```kconfig
# ESP32-S3 target
CONFIG_IDF_TARGET="esp32s3"

# NimBLE host stack (supports BLE 5.0 extended advertising)
CONFIG_BT_ENABLED=y
CONFIG_BT_NIMBLE_ENABLED=y
CONFIG_BT_CONTROLLER_ENABLED=y

# BLE 5.0 extended advertising support
CONFIG_BT_NIMBLE_EXT_ADV=y

# BLE only, no classic BT (ESP32-S3 doesn't have classic anyway)
CONFIG_BT_CTRL_MODE_EFF=1

# Console via CP2102 UART (Heltec V3 routes USB through external UART bridge)
CONFIG_ESP_CONSOLE_UART_DEFAULT=y

# Logging
CONFIG_LOG_DEFAULT_LEVEL_INFO=y
CONFIG_LOG_MAXIMUM_LEVEL_DEBUG=y

# Stack size
CONFIG_ESP_MAIN_TASK_STACK_SIZE=8192
```

## utilities/esp32-ble-sniffer/sdkconfig.defaults
```kconfig
# BLE controller only — no host stack (we use VHCI directly)
CONFIG_BT_ENABLED=y
CONFIG_BT_CONTROLLER_ONLY=y
CONFIG_BT_CONTROLLER_ENABLED=y

# BLE only, no classic BT
CONFIG_BT_CTRL_MODE_EFF=1
CONFIG_BT_CTRL_BLE_MAX_ACT=6

# VHCI enabled
CONFIG_BT_CTRL_HCI_MODE_VHCI=y

# Scan duplicate filtering off — we want every packet
CONFIG_BT_CTRL_SCAN_DUPL_TYPE_DEVICE=y

# Console / UART for serial commands
CONFIG_ESP_CONSOLE_UART_DEFAULT=y
CONFIG_ESP_CONSOLE_UART_BAUDRATE=115200

# Logging — verbose to capture all BLE/HCI traffic
CONFIG_LOG_DEFAULT_LEVEL_DEBUG=y
CONFIG_LOG_MAXIMUM_LEVEL_VERBOSE=y

# Increase main task stack for printf-heavy output
CONFIG_ESP_MAIN_TASK_STACK_SIZE=4096
```
